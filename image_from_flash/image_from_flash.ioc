# file: image_from_flash.ioc
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Mcu.Family=STM32F1
Mcu.Name=STM32F103C(8-B)Tx
Mcu.Package=LQFP48
NVIC.PriorityGroup=NVIC_PRIORITYGROUP_4
PA13.Mode=Serial_Wire
PA13.Signal=SYS_JTMS-SWDIO
PA14.Mode=Serial_Wire
PA14.Signal=SYS_JTCK-SWCLK
ProjectManager.HeapSize=0x200
ProjectManager.StackSize=0x400
ProjectManager.TargetToolchain=STM32CubeIDE
RCC.APB1Freq_Value=8000000
RCC.APB2Freq_Value=8000000
board=custom

// file: Core/Src/main.c
/* USER CODE BEGIN Header */
/**
  ******************************************************************************
  * @file           : main.c
  * @brief          : Main program body
  ******************************************************************************
  * @attention
  *
  * Copyright (c) 2025 STMicroelectronics.
  * All rights reserved.
  *
  * This software is licensed under terms that can be found in the LICENSE file
  * in the root directory of this software component.
  * If no LICENSE file comes with this software, it is provided AS-IS.
  *
  ******************************************************************************
  */
/* USER CODE END Header */
#include "main.h"

/* USER CODE BEGIN Includes */
#include "spfd54124b.h"
#include "nokia1661_lcd_driver.h"

#include "EleQuo_img.h"

/* USER CODE END Includes */

/* USER CODE BEGIN PD */
#if defined(LCD_STM_HW)
void delay_ms(uint32_t __IO delay)
{
	delay *=((SystemCoreClock/1000000)/5)*643;
	while(delay--);
}
#endif
/* USER CODE END PD */

void SystemClock_Config(void);
/* USER CODE BEGIN PFP */
void show_image_from_array(const uint8_t *image_data);
/* USER CODE END PFP */

int main(void)
{

  /* MCU Configuration--------------------------------------------------------*/

  /* Reset of all peripherals, Initializes the Flash interface and the Systick. */
  HAL_Init();

  /* Configure the system clock */
  SystemClock_Config();

  /* Initialize all configured peripherals */
  /* USER CODE BEGIN 2 */
  nlcdInit();
  nlcdClear();
  nlcdSetOrientation(LCD_ORIENTATION_90);

  show_image_from_array(image_data);

  /* USER CODE END 2 */

  /* Infinite loop */
  while (1)
  {

  }
}

void SystemClock_Config(void)
{
  RCC_OscInitTypeDef RCC_OscInitStruct = {0};
  RCC_ClkInitTypeDef RCC_ClkInitStruct = {0};

  /** Initializes the RCC Oscillators according to the specified parameters
  * in the RCC_OscInitTypeDef structure.
  */
  RCC_OscInitStruct.OscillatorType = RCC_OSCILLATORTYPE_HSI;
  RCC_OscInitStruct.HSIState = RCC_HSI_ON;
  RCC_OscInitStruct.HSICalibrationValue = RCC_HSICALIBRATION_DEFAULT;
  RCC_OscInitStruct.PLL.PLLState = RCC_PLL_NONE;
  if (HAL_RCC_OscConfig(&RCC_OscInitStruct) != HAL_OK)
  {
    Error_Handler();
  }

  /** Initializes the CPU, AHB and APB buses clocks
  */
  RCC_ClkInitStruct.ClockType = RCC_CLOCKTYPE_HCLK|RCC_CLOCKTYPE_SYSCLK
                              |RCC_CLOCKTYPE_PCLK1|RCC_CLOCKTYPE_PCLK2;
  RCC_ClkInitStruct.SYSCLKSource = RCC_SYSCLKSOURCE_HSI;
  RCC_ClkInitStruct.AHBCLKDivider = RCC_SYSCLK_DIV1;
  RCC_ClkInitStruct.APB1CLKDivider = RCC_HCLK_DIV1;
  RCC_ClkInitStruct.APB2CLKDivider = RCC_HCLK_DIV1;

  if (HAL_RCC_ClockConfig(&RCC_ClkInitStruct, FLASH_LATENCY_0) != HAL_OK)
  {
    Error_Handler();
  }
}

/* USER CODE BEGIN 4 */

/**
 * @brief  Displays an image on the LCD from a C array in flash memory.
 * @note   The array must have the same format as the .bin file:
 * 4-byte header (x, y, w, h) followed by 16-bit (RGB565 Big Endian) pixel data.
 * @param  image_data Pointer to the constant array holding the image data.
 */
void show_image_from_array(const uint8_t *image_data)
{
    // Check if the pointer is NULL
    if (image_data == NULL) return;

    // Extract the header data: x-coordinate, y-coordinate, width, and height
    uint8_t x = image_data[0];
    uint8_t y = image_data[1];
    uint8_t w = image_data[2];
    uint8_t h = image_data[3];

    // Check for invalid dimensions
    if (w == 0 || h == 0) return;

    // Pointer to the start of the pixel data (after the 4-byte header)
    const uint8_t *pixel_ptr = &image_data[4];
    // Calculate the total number of pixels to display
    uint32_t total_pixels = (uint32_t)w * h;

    // Set the display window (area) for the image
    _nlcdSetWindow(x, y, w, h);
    // Send the command to start writing to RAM (pixel data)
    _nlcdSendCmd(SPFD54124B_CMD_RAMWR);

    // Loop through all pixels in the image
    for (uint32_t i = 0; i < total_pixels; i++)
    {
        // 16-bit color data (RGB565)
        // Read the Big Endian 16-bit color: MSB is the first byte, LSB is the second
        uint16_t color = (*pixel_ptr++ << 8); // Read MSB and shift it to the high byte
        color |= *pixel_ptr++;                // Read LSB and combine with MSB

#ifdef DISPLAY_BGR_MODE
        // --- Swap Red and Blue components (if in BGR mode) ---
        uint16_t corrected_color = ((color & 0xF800) >> 11) |     // R (5 bits) -> B position
                                   (color & 0x07E0) |             // G (6 bits) remains unchanged
                                   ((color & 0x001F) << 11);      // B (5 bits) -> R position
        _nlcdSendPixel(corrected_color);
#else
        // Normal mode (RGB)
        _nlcdSendPixel(color);
#endif
    }

    // Send No Operation command (or similar) to signify the end of the drawing operation
    _nlcdSendCmd(SPFD54124B_CMD_NOP);
}

/* USER CODE END 4 */

void Error_Handler(void)
{
  __disable_irq();
  while (1)
  {
  }
}
